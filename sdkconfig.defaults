## sdkconfig.defaults
```kconfig
CONFIG_TINYUSB_DESC_MANUFACTURER_STRING="VRC"
CONFIG_TINYUSB_DESC_PRODUCT_STRING="zeusbot controller"

#
# Communication Device Class (CDC)
#
CONFIG_TINYUSB_CDC_ENABLED=y
CONFIG_TINYUSB_CDC_COUNT=2
CONFIG_TINYUSB_CDC_RX_BUFSIZE=512
CONFIG_TINYUSB_CDC_TX_BUFSIZE=512



#
# micro-ROS Settings
#
CONFIG_MICRO_ROS_ESP_XRCE_DDS_MIDDLEWARE=y
# CONFIG_MICRO_ROS_ESP_EMBEDDEDRTPS_MIDDLEWARE is not set
# CONFIG_MICRO_ROS_ESP_NETIF_WLAN is not set
# CONFIG_MICRO_ROS_ESP_NETIF_ENET is not set
CONFIG_MICRO_ROS_ESP_UART_TRANSPORT=y

CONFIG_ESP_WIFI_SSID="AAP"
CONFIG_ESP_WIFI_PASSWORD="Pawan123"
CONFIG_ESP_MAXIMUM_RETRY=5

# mpu config
CONFIG_MPU6500=y
CONFIG_MPU_CHIP_MODEL="MPU6500"
```
